## config/boards/arm/zitaotech_q10/dts/bindings/zmk,behavior-double-tap-toggle.yaml
```yaml
# SPDX-License-Identifier: MIT

description: |
  Toggle-style key with an instant single tap and a double tap. Every press runs the first binding
  at once, so a single tap has no delay. A second press within tapping-term-ms of the first runs the
  first binding again, which undoes a toggle such as Scroll Lock, and then taps the second binding.
  Example: bindings = <&kp SLCK>, <&kp CAPS>;

compatible: "zmk,behavior-double-tap-toggle"

include: zero_param.yaml

properties:
  bindings:
    type: phandle-array
    required: true
  tapping-term-ms:
    type: int
    default: 400
```

## config/boards/arm/zitaotech_q10/dts/bindings/zmk,behavior-trackpad-click.yaml
```yaml
# SPDX-License-Identifier: MIT

description: |
  Trackpad click. A short press taps the first binding, moving the trackpad while it is pressed
  holds the first binding (drag), and holding the trackpad still for long-press-ms taps the second
  binding. Usage: &tpc <click param> <long press param>, e.g. &tpc LCLK RCLK with bindings = <&mkp>, <&mkp>.

compatible: "zmk,behavior-trackpad-click"

include: two_param.yaml

properties:
  bindings:
    type: phandles
    required: true
  long-press-ms:
    type: int
    default: 1000
  move-threshold:
    type: int
    default: 6
    description: Trackpad motion (|dx| + |dy| in sensor counts) that turns the press into a drag
```
